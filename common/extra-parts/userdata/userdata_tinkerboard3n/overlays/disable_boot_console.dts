/dts-v1/;
/plugin/;

/ {
	compatible = "rockchip,rk3568";

        fragment@0 {
                target-path = "/";
                __overlay__ {
                        chosen: chosen {
                                bootargs = " quiet earlycon=uart8250,mmio32,0xfe660000 console=ttyFIQ0 rw rootwait";
                        };
		};
        };

};
