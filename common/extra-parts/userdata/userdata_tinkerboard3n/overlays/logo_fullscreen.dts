/dts-v1/;
/plugin/;

/ {
	compatible = "rockchip,rk3568";

        fragment@0 {
                target = <&route_hdmi>;
                __overlay__ {
			logo,mode = "fullscreen";
			charge_logo,mode = "fullscreen";
		};
        };

};
