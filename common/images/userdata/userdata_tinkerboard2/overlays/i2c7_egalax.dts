/dts-v1/;
/plugin/;
/ {
	compatible = "rockchip,rk3399";

	fragment@0 {
		target = <&i2c7>;
		__overlay__ {

			egalax_i2c@2a {
				compatible = "eeti,egalax_i2c";
				reg = <0x2a>;
				interrupt-parent = <&gpio3>;
				interrupts = <30 8>;
				int-gpios = <&gpio3 30 0>;
				status = "okay";
			};
		};
	};
};
